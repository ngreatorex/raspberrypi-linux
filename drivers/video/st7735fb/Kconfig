## drivers/video/st7735fb/Kconfig
```kconfig
config FB_ST7735
        tristate "ST7735 framebuffer support"
        depends on FB
        select FB_SYS_FILLRECT
        select FB_SYS_COPYAREA
        select FB_SYS_IMAGEBLIT
        select FB_DEFERRED_IO
        select FB_SYS_FOPS
        help
          Support for ST7735 framebuffer device family

config FB_ST7735_PANEL_TYPE_RED_TAB
       bool "ST7735 panel is 'red tab' type?"
       depends on FB_ST7735
       default y
       help
         Choose "y" for a "red tab" ST7735 panel.
         Choose "n" for a "green tab" ST7735 panel.

config FB_ST7735_MAP
        tristate "ST7735 framebuffer mapping to SPI0.0"
        depends on FB_ST7735
        default n
        help
          Include support for an ST7735FB display on SPI0, CS0.

config FB_ST7735_MAP_RST_GPIO
       int "ST7735 RST gpio pin number"
       depends on FB_ST7735_MAP
       default "-1"
       help
         Enter the gpio pin number wired to the ST7735 RST pin
         (or provide the pin number as param ".rst_gpio")

config FB_ST7735_MAP_DC_GPIO
       int "ST7735 D/C gpio pin number"
       depends on FB_ST7735_MAP
       default "-1"
       help
         Enter the gpio pin number wired to the ST7735 D/C pin
         (or provide the pin number as param ".dc_gpio")

config FB_ST7735_MAP_SPI_BUS_NUM
       int "ST7735 SPI bus number"
       depends on FB_ST7735_MAP
       default "0"

config FB_ST7735_MAP_SPI_BUS_CS
       int "ST7735 SPI bus chipselect"
       depends on FB_ST7735_MAP
       default "0"

config FB_ST7735_MAP_SPI_BUS_SPEED
       int "ST7735 SPI bus clock speed (Hz)"
       depends on FB_ST7735_MAP
       default "4000000"

config FB_ST7735_MAP_SPI_BUS_MODE
       int "ST7735 SPI bus mode (0, 1, 2, or 3)"
       depends on FB_ST7735_MAP
       default "0"
```
